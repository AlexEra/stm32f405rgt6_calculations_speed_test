# file: bin_calculating_tst.ioc
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Mcu.Family=STM32F4
RCC.VCOOutputFreq_Value=192000000
RCC.APB2Freq_Value=16000000
RCC.CortexFreq_Value=16000000
PA14.Mode=Serial_Wire
PA13.Mode=Serial_Wire
Mcu.Name=STM32F405RGTx
RCC.SYSCLKFreq_VALUE=16000000
Mcu.Package=LQFP64
ProjectManager.StackSize=0x400
PA13.Signal=SYS_JTMS-SWDIO
PA14.Signal=SYS_JTCK-SWCLK
ProjectManager.HeapSize=0x200
ProjectManager.TargetToolchain=STM32CubeIDE
RCC.HSI_VALUE=16000000
NVIC.PriorityGroup=NVIC_PRIORITYGROUP_4
RCC.APB1Freq_Value=16000000
RCC.LSE_VALUE=32768
RCC.AHBFreq_Value=16000000
RCC.HSE_VALUE=25000000
board=custom

// file: Core/Src/main.c
/* USER CODE BEGIN Header */
/**
  ******************************************************************************
  * @file           : main.c
  * @brief          : Main program body
  ******************************************************************************
  * @attention
  *
  * <h2><center>&copy; Copyright (c) 2021 STMicroelectronics.
  * All rights reserved.</center></h2>
  *
  * This software component is licensed by ST under BSD 3-Clause license,
  * the "License"; You may not use this file except in compliance with the
  * License. You may obtain a copy of the License at:
  *                        opensource.org/licenses/BSD-3-Clause
  *
  ******************************************************************************
  */
/* USER CODE END Header */
#include "main.h"

/* USER CODE BEGIN PV */
#define    DWT_CYCCNT    *(volatile unsigned long *)0xE0001004
#define    DWT_CONTROL   *(volatile unsigned long *)0xE0001000
#define    SCB_DEMCR     *(volatile unsigned long *)0xE000EDFC
uint32_t count_tic = 0;
float calculation_time_0 = 0;
float calculation_time_1 = 0;

uint16_t a = 311;
uint8_t first_byte = 0;
uint8_t	second_byte = 0;
uint8_t first_val = 0;
uint8_t	second_val = 0;
uint8_t third_val = 0;
uint8_t	fourth_val = 0;
/* USER CODE END PV */

void SystemClock_Config(void);
static void MX_GPIO_Init(void);

int main(void)
{

  /* MCU Configuration--------------------------------------------------------*/

  /* Reset of all peripherals, Initializes the Flash interface and the Systick. */
  HAL_Init();

  /* Configure the system clock */
  SystemClock_Config();

  /* Initialize all configured peripherals */
  MX_GPIO_Init();

  /* Infinite loop */
  /* USER CODE BEGIN WHILE */
  SCB_DEMCR |= CoreDebug_DEMCR_TRCENA_Msk; // enable DWT
  DWT_CYCCNT = 0; // zeroing counter
  DWT_CONTROL|= DWT_CTRL_CYCCNTENA_Msk; // enable counter
  while (1) {
	  /* first way
	   * this way is faster, than second!!
	   */
	  first_byte = a & 0x00FF;  // 1 byte
	  second_byte = (a & 0xFF00) >> 8;  // 2 byte
	  count_tic = DWT_CYCCNT;
	  DWT_CYCCNT = 0;
	  calculation_time_0 = (float) count_tic / 8000000;
	  DWT_CYCCNT = 0; // zeroing counter

	  /* second way */
	  first_val = a / 1000;
	  second_val = (a % 1000) / 100;
	  third_val = ((a % 1000) % 100) / 10;
	  fourth_val = ((a % 1000) % 100) % 10;
	  count_tic = DWT_CYCCNT;
	  DWT_CYCCNT = 0;
	  calculation_time_1 = (float) count_tic / 8000000;
	  DWT_CYCCNT = 0; // zeroing counter
    /* USER CODE END WHILE */

  }
}

void SystemClock_Config(void)
{
  RCC_OscInitTypeDef RCC_OscInitStruct = {0};
  RCC_ClkInitTypeDef RCC_ClkInitStruct = {0};

  /** Configure the main internal regulator output voltage
  */
  __HAL_RCC_PWR_CLK_ENABLE();
  __HAL_PWR_VOLTAGESCALING_CONFIG(PWR_REGULATOR_VOLTAGE_SCALE1);
  /** Initializes the RCC Oscillators according to the specified parameters
  * in the RCC_OscInitTypeDef structure.
  */
  RCC_OscInitStruct.OscillatorType = RCC_OSCILLATORTYPE_HSI;
  RCC_OscInitStruct.HSIState = RCC_HSI_ON;
  RCC_OscInitStruct.HSICalibrationValue = RCC_HSICALIBRATION_DEFAULT;
  RCC_OscInitStruct.PLL.PLLState = RCC_PLL_NONE;
  if (HAL_RCC_OscConfig(&RCC_OscInitStruct) != HAL_OK)
  {
    Error_Handler();
  }
  /** Initializes the CPU, AHB and APB buses clocks
  */
  RCC_ClkInitStruct.ClockType = RCC_CLOCKTYPE_HCLK|RCC_CLOCKTYPE_SYSCLK
                              |RCC_CLOCKTYPE_PCLK1|RCC_CLOCKTYPE_PCLK2;
  RCC_ClkInitStruct.SYSCLKSource = RCC_SYSCLKSOURCE_HSI;
  RCC_ClkInitStruct.AHBCLKDivider = RCC_SYSCLK_DIV1;
  RCC_ClkInitStruct.APB1CLKDivider = RCC_HCLK_DIV1;
  RCC_ClkInitStruct.APB2CLKDivider = RCC_HCLK_DIV1;

  if (HAL_RCC_ClockConfig(&RCC_ClkInitStruct, FLASH_LATENCY_0) != HAL_OK)
  {
    Error_Handler();
  }
}

static void MX_GPIO_Init(void)
{

  /* GPIO Ports Clock Enable */
  __HAL_RCC_GPIOA_CLK_ENABLE();

}

void Error_Handler(void)
{
  __disable_irq();
  while (1)
  {
  }
}

/************************ (C) COPYRIGHT STMicroelectronics *****END OF FILE****/
